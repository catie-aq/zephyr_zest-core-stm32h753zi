## boards/arm/zest_core_stm32h753zi/Kconfig.board
```kconfig
# Copyright (c) 2024 CATIE
# SPDX-License-Identifier: Apache-2.0

config BOARD_ZEST_CORE_STM32H753ZI
	bool "Zest_Core_STM32H753ZI Development Board"
	depends on SOC_STM32H753XX
```

## boards/arm/zest_core_stm32h753zi/Kconfig.defconfig
```kconfig
# Copyright (c) 2024 CATIE
# SPDX-License-Identifier: Apache-2.0

if BOARD_ZEST_CORE_STM32H753ZI

config BOARD
	default "zest_core_stm32h753zi"

if NETWORKING

config NET_L2_ETHERNET
	default y

endif # NETWORKING

endif # BOARD_ZEST_CORE_STM32H753ZI
```

## boards/catie/zest_core_stm32h753zi/Kconfig.defconfig
```kconfig
# Copyright (c) 2024 CATIE
# SPDX-License-Identifier: Apache-2.0

if BOARD_ZEST_CORE_STM32H753ZI

if NETWORKING

config NET_L2_ETHERNET
	default y

endif # NETWORKING

endif # BOARD_ZEST_CORE_STM32H753ZI
```
